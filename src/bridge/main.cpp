//
// AirMQ SensorNode — firmware migration bridge (ESP32 + ESP8266)
//
// ESP32:  Phase 1 — detects partition table mismatch, writes new PT + blank
//                   otadata, reboots.
//         Phase 2 — starts AP + bare OTA page to accept real SensorNode fw.
//
// ESP8266: No partition table concept — goes straight to AP + OTA page.
//          (Filesystem is reformatted on first boot by storageInit().)
//
#include <Arduino.h>

#ifdef ESP8266
#  include <ESP8266WiFi.h>
#  include <ESP8266WebServer.h>
   typedef ESP8266WebServer WebServerT;
#  define OTA_BEGIN(sz)  Update.begin(sz)
#  define OTA_ERR()      Update.getErrorString()
#  define RESTART()      ESP.restart()
#else
#  include <WiFi.h>
#  include <WebServer.h>
#  include <Update.h>
#  include "esp_spi_flash.h"
#  include "target_partitions.h"   // generated by scripts/gen_partition_header.py
   typedef WebServer WebServerT;
#  define OTA_BEGIN(sz)  Update.begin(UPDATE_SIZE_UNKNOWN)
#  define OTA_ERR()      Update.errorString()
#  define RESTART()      esp_restart()
#endif

#ifndef BRIDGE_AP_SSID
#  define BRIDGE_AP_SSID "AirMQ-Migrate"
#endif
#ifndef BRIDGE_AP_PASS
#  define BRIDGE_AP_PASS "airmq1234"
#endif

static WebServerT server(80);

// ─── ESP32: partition table migration ────────────────────────────────────────

#ifndef ESP8266

static bool ptMatches() {
    if (target_partitions_bin_len == 0) return false;
    uint8_t* buf = (uint8_t*)malloc(target_partitions_bin_len);
    if (!buf) return false;
    esp_err_t err = spi_flash_read(TARGET_PT_OFFSET, buf, target_partitions_bin_len);
    bool ok = (err == ESP_OK) &&
              (memcmp(buf, target_partitions_bin, target_partitions_bin_len) == 0);
    free(buf);
    return ok;
}

static bool migratePartitionTable() {
    Serial.println("[bridge] Erasing partition table sector...");
    if (spi_flash_erase_range(TARGET_PT_OFFSET, 0x1000) != ESP_OK) {
        Serial.println("[bridge] Erase failed");
        return false;
    }
    Serial.println("[bridge] Writing new partition table...");
    if (spi_flash_write(TARGET_PT_OFFSET,
                        target_partitions_bin,
                        target_partitions_bin_len) != ESP_OK) {
        Serial.println("[bridge] Write failed");
        return false;
    }
    Serial.println("[bridge] Resetting otadata (boot → ota_0)...");
    spi_flash_erase_range(TARGET_OTD_OFFSET, TARGET_OTD_SIZE);
    return true;
}

#endif // !ESP8266

// ─── OTA web page ─────────────────────────────────────────────────────────────

static const char HTML[] PROGMEM = R"(<!DOCTYPE html>
<html><head><meta charset="utf-8"><title>AirMQ Migration</title>
<style>body{font-family:sans-serif;max-width:480px;margin:40px auto;padding:0 16px}
h2{color:#2d6a4f}progress{width:100%;margin-top:8px}</style></head>
<body>
<h2>AirMQ Firmware Migration</h2>
<p>Upload the SensorNode firmware binary to complete installation.</p>
<form id=f method=POST action=/ota enctype=multipart/form-data>
  <input type=file name=firmware accept=.bin required><br><br>
  <button type=submit>Flash &amp; Reboot</button>
</form>
<progress id=p style="display:none"></progress>
<p id=msg></p>
<script>
document.getElementById('f').onsubmit=function(e){
  e.preventDefault();
  var fd=new FormData(this),p=document.getElementById('p'),m=document.getElementById('msg');
  p.style.display='block'; p.removeAttribute('value');
  m.textContent='Uploading...';
  var x=new XMLHttpRequest();
  x.upload.onprogress=function(ev){if(ev.lengthComputable){p.max=ev.total;p.value=ev.loaded;}};
  x.onload=function(){m.textContent=x.status===200?'Done \u2014 rebooting':'Error: '+x.responseText;};
  x.onerror=function(){m.textContent='Upload error';};
  x.open('POST','/ota'); x.send(fd);
};
</script>
</body></html>)";

// ─── OTA handlers ─────────────────────────────────────────────────────────────

static bool otaBeginOk = false;

static void handleOtaUpload() {
    HTTPUpload& u = server.upload();
    if (u.status == UPLOAD_FILE_START) {
        otaBeginOk = OTA_BEGIN(u.contentLength);
        Serial.println(otaBeginOk ? "[bridge] OTA begin OK" :
                       String("[bridge] OTA begin failed: ") + OTA_ERR());
    } else if (u.status == UPLOAD_FILE_WRITE) {
        if (otaBeginOk &&
            Update.write(u.buf, u.currentSize) != u.currentSize)
            Serial.println("[bridge] OTA write error");
    } else if (u.status == UPLOAD_FILE_END) {
        if (otaBeginOk) {
            if (Update.end(true)) Serial.println("[bridge] OTA complete");
            else Serial.println(String("[bridge] OTA end failed: ") + OTA_ERR());
        }
    }
}

static void handleOtaResponse() {
    if (!otaBeginOk || Update.hasError()) {
        server.send(500, "text/plain", String("OTA failed: ") + OTA_ERR());
    } else {
        server.send(200, "text/plain", "OK \xe2\x80\x94 rebooting");
        Serial.println("[bridge] OTA done — rebooting");
        delay(500);
        RESTART();
    }
}

// ─── Setup / loop ─────────────────────────────────────────────────────────────

static void startOtaServer() {
    WiFi.softAP(BRIDGE_AP_SSID, BRIDGE_AP_PASS);
    Serial.printf("[bridge] AP \"%s\" @ %s\n",
                  BRIDGE_AP_SSID, WiFi.softAPIP().toString().c_str());
    server.on("/", HTTP_GET, []() {
        server.send_P(200, "text/html", HTML);
    });
    server.on("/ota", HTTP_POST, handleOtaResponse, handleOtaUpload);
    server.onNotFound([]() {
        server.sendHeader("Location", "http://192.168.4.1/", true);
        server.send(302, "text/plain", "");
    });
    server.begin();
    Serial.println("[bridge] HTTP server on port 80");
}

void setup() {
    Serial.begin(115200);
    delay(200);
    Serial.println("\n[bridge] AirMQ migration bridge");

#ifndef ESP8266
    if (!ptMatches()) {
        Serial.println("[bridge] Partition table mismatch — migrating");
        if (migratePartitionTable()) {
            Serial.println("[bridge] Migration OK — rebooting");
            delay(500);
            RESTART();
        } else {
            Serial.println("[bridge] Migration FAILED — halting. Use serial flash.");
            for (;;) delay(1000);
        }
        // not reached
    }
    Serial.println("[bridge] Partition table OK");
#endif

    startOtaServer();
}

void loop() {
    server.handleClient();
}
